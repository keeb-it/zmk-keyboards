## boards/shields/acorn/Kconfig.defconfig
```kconfig
if SHIELD_ACORN_CENTRAL_DONGLE || SHIELD_ACORN_CENTRAL_LEFT

config ZMK_SPLIT_ROLE_CENTRAL
    default y

endif

if SHIELD_ACORN_CENTRAL_DONGLE

config ZMK_KEYBOARD_NAME
    default "acorn.dongle"

endif

if SHIELD_ACORN_CENTRAL_LEFT

config ZMK_KEYBOARD_NAME
    default "acorn.central"

endif

if SHIELD_ACORN_PERIPHERAL_LEFT

config ZMK_KEYBOARD_NAME
    default "acorn.left"

endif

if SHIELD_ACORN_PERIPHERAL_RIGHT

config ZMK_KEYBOARD_NAME
    default "acorn.right"

endif

if SHIELD_ACORN_CENTRAL_DONGLE || SHIELD_ACORN_CENTRAL_LEFT || SHIELD_ACORN_PERIPHERAL_LEFT || SHIELD_ACORN_PERIPHERAL_RIGHT

config ZMK_SPLIT
    default y
    
config EC11
    default y

choice EC11_TRIGGER_MODE
    default EC11_TRIGGER_GLOBAL_THREAD
    depends on EC11
endchoice

config ZMK_SLEEP
    default y

endif
```

## boards/shields/acorn/Kconfig.shield
```kconfig
# Copyright (c) 2020 The ZMK Contributors
# SPDX-License-Identifier: MIT

config SHIELD_ACORN_CENTRAL_DONGLE
	def_bool $(shields_list_contains,acorn_central_dongle)

config SHIELD_ACORN_CENTRAL_LEFT
    def_bool $(shields_list_contains,acorn_central_left)

config SHIELD_ACORN_PERIPHERAL_LEFT
    def_bool $(shields_list_contains,acorn_peripheral_left)

config SHIELD_ACORN_PERIPHERAL_RIGHT
    def_bool $(shields_list_contains,acorn_peripheral_right)
```

## boards/shields/coral/Kconfig.defconfig
```kconfig
if SHIELD_CORAL_LEFT

config ZMK_SPLIT_ROLE_CENTRAL
    default y

config ZMK_KEYBOARD_NAME
    default "coral.central"

endif

if SHIELD_CORAL_RIGHT

config ZMK_KEYBOARD_NAME
    default "coral.right"

endif

if SHIELD_CORAL_LEFT || SHIELD_CORAL_RIGHT

config ZMK_SPLIT_WIRED
    default y

config ZMK_SPLIT
    default y

config ZMK_USB_LOGGING
    default n

config EC11
    default y
    
choice EC11_TRIGGER_MODE
    default EC11_TRIGGER_GLOBAL_THREAD
    depends on EC11
endchoice

endif
```

## boards/shields/coral/Kconfig.shield
```kconfig
# Copyright (c) 2020 The ZMK Contributors
# SPDX-License-Identifier: MIT

config SHIELD_CORAL_LEFT
    def_bool $(shields_list_contains,coral_left)

config SHIELD_CORAL_RIGHT
    def_bool $(shields_list_contains,coral_right)
```

## boards/shields/hammer40/Kconfig.defconfig
```kconfig
# Copyright (c) 2020 The ZMK Contributors
# SPDX-License-Identifier: MIT

if SHIELD_HAMMER40

config ZMK_KEYBOARD_NAME
    default "hammer40"

config SPI
    default y

config I2C
    default y

config EC11
    default y

choice EC11_TRIGGER_MODE
    default EC11_TRIGGER_GLOBAL_THREAD
    depends on EC11
endchoice

config ZMK_USB_LOGGING
    default n

config ZMK_SLEEP
    default y

if ZMK_DISPLAY

config SSD1306
    default y

choice LV_FONT_DEFAULT
    default LV_FONT_DEFAULT_MONTSERRAT_12
endchoice

choice ZMK_LV_FONT_DEFAULT_SMALL
    default ZMK_LV_FONT_DEFAULT_SMALL_MONTSERRAT_12
endchoice

config LV_Z_VDB_SIZE
    default 64

config LV_DPI_DEF
    default 148

config LV_Z_BITS_PER_PIXEL
    default 1

choice LV_COLOR_DEPTH
    default LV_COLOR_DEPTH_1
endchoice

endif # ZMK_DISPLAY

endif
```

## boards/shields/hana/Kconfig.defconfig
```kconfig
if SHIELD_HANA_CENTRAL_DONGLE || SHIELD_HANA_CENTRAL_LEFT

config ZMK_SPLIT_ROLE_CENTRAL
    default y

endif

if SHIELD_HANA_CENTRAL_DONGLE

config ZMK_KEYBOARD_NAME
    default "hana.dongle"

endif

if SHIELD_HANA_CENTRAL_LEFT

config ZMK_KEYBOARD_NAME
    default "hana.central"

endif

if SHIELD_HANA_PERIPHERAL_LEFT

config ZMK_KEYBOARD_NAME
    default "hana.left"

endif

if SHIELD_HANA_PERIPHERAL_RIGHT

config ZMK_KEYBOARD_NAME
    default "hana.right"

endif

if SHIELD_HANA_CENTRAL_DONGLE || SHIELD_HANA_CENTRAL_LEFT || SHIELD_HANA_PERIPHERAL_LEFT || SHIELD_HANA_PERIPHERAL_RIGHT

config ZMK_SPLIT
    default y

config SPI
    default y

config I2C
    default y

if ZMK_DISPLAY

config SSD1306
    default y

choice LV_FONT_DEFAULT
    default LV_FONT_DEFAULT_MONTSERRAT_12
endchoice

choice ZMK_LV_FONT_DEFAULT_SMALL
    default ZMK_LV_FONT_DEFAULT_SMALL_MONTSERRAT_12
endchoice

config LV_Z_VDB_SIZE
    default 64

config LV_DPI_DEF
    default 148

config LV_Z_BITS_PER_PIXEL
    default 1

choice LV_COLOR_DEPTH
    default LV_COLOR_DEPTH_1
endchoice

endif # ZMK_DISPLAY

endif
```

## boards/shields/hana/Kconfig.shield
```kconfig
# Copyright (c) 2020 The ZMK Contributors
# SPDX-License-Identifier: MIT

config SHIELD_HANA_CENTRAL_DONGLE
	def_bool $(shields_list_contains,hana_central_dongle)

config SHIELD_HANA_CENTRAL_LEFT
    def_bool $(shields_list_contains,hana_central_left)

config SHIELD_HANA_PERIPHERAL_LEFT
    def_bool $(shields_list_contains,hana_peripheral_left)

config SHIELD_HANA_PERIPHERAL_RIGHT
    def_bool $(shields_list_contains,hana_peripheral_right)
```

## config/boards/shields/hammer40/Kconfig.defconfig
```kconfig
# Copyright (c) 2020 The ZMK Contributors
# SPDX-License-Identifier: MIT

if SHIELD_HAMMER40

config ZMK_KEYBOARD_NAME
    default "hammer40"

config SPI
    default y

if ZMK_DISPLAY

config I2C
    default y

config SSD1306
    default y

choice LV_FONT_DEFAULT
    default LV_FONT_DEFAULT_MONTSERRAT_12
endchoice

choice ZMK_LV_FONT_DEFAULT_SMALL
    default ZMK_LV_FONT_DEFAULT_SMALL_MONTSERRAT_12
endchoice

config LV_Z_VDB_SIZE
    default 64

config LV_DPI_DEF
    default 148

config LV_Z_BITS_PER_PIXEL
    default 1

choice LV_COLOR_DEPTH
    default LV_COLOR_DEPTH_1
endchoice

endif # ZMK_DISPLAY

endif
```

## config/west.yml
```yaml
manifest:
  remotes:
    - name: upstream
      url-base: https://github.com/zmkfirmware
  projects:
    - name: zmk
      remote: upstream
      revision: main
      import: app/west.yml
  self:
    path: config
```
