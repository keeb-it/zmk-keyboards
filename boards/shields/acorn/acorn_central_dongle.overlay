#include "acorn_matrix.dtsi"

/delete-node/ &kscan;

/ {
    chosen {
        zmk,kscan = &mock_kscan;
    };

    mock_kscan: kscan1 {
        compatible = "zmk,kscan-mock";
        columns = <0>;
        rows = <0>;
        events = <0>;
    };
};
