#include "acorn.dtsi"

&six_col_transform {
    col-offset = <6>;
};

&five_col_transform {
    col-offset = <5>;
};

&kscan {
    col-gpios
        = <&pro_micro 18 (GPIO_ACTIVE_HIGH)>
        , <&pro_micro 15 (GPIO_ACTIVE_HIGH)>
        , <&pro_micro 20 (GPIO_ACTIVE_HIGH)>
        , <&pro_micro 5 (GPIO_ACTIVE_HIGH)>
        , <&pro_micro 4 (GPIO_ACTIVE_HIGH)>
        , <&pro_micro 21 (GPIO_ACTIVE_HIGH)>
        ;
};


&right_encoder {
    status = "okay";
    a-gpios = <&pro_micro 9 (GPIO_ACTIVE_HIGH | GPIO_PULL_UP)>;
    b-gpios = <&pro_micro 10 (GPIO_ACTIVE_HIGH | GPIO_PULL_UP)>;
};
