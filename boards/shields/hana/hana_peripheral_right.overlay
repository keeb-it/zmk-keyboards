#include "hana.dtsi"

&default_transform {
    col-offset = <8>;
};

&kscan {
    col-gpios
        = <&shift_reg 1 (GPIO_ACTIVE_HIGH)>
        , <&shift_reg 2 (GPIO_ACTIVE_HIGH)>
        , <&shift_reg 0 (GPIO_ACTIVE_HIGH)>
        , <&shift_reg 7 (GPIO_ACTIVE_HIGH)>
        , <&shift_reg 6 (GPIO_ACTIVE_HIGH)>
        , <&shift_reg 5 (GPIO_ACTIVE_HIGH)>
        , <&shift_reg 4 (GPIO_ACTIVE_HIGH)>
        , <&shift_reg 3 (GPIO_ACTIVE_HIGH)>
        ;
};

&right_encoder {
    status = "okay";
    a-gpios = <&xiao_d 9 (GPIO_ACTIVE_HIGH | GPIO_PULL_UP)>;
    b-gpios = <&xiao_d 3 (GPIO_ACTIVE_HIGH | GPIO_PULL_UP)>;
};
