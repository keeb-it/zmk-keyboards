/ {
    chosen {
        zephyr,display = &snippet_oled_128x64;
    };
};

&i2c0 {
    status = "okay";

    snippet_oled_128x64: ssd1306@3c {
        compatible = "solomon,ssd1306fb";
        reg = <0x3c>;
        width = <128>;
        height = <64>;
        segment-offset = <0>;
        page-offset = <0>;
        display-offset = <0>;
        multiplex-ratio = <63>;
        prechargep = <0x22>;
        inversion-on;
    };
};
